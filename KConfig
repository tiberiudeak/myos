## KConfig
```kconfig
mainmenu "MyOS x86_32 Kernel Configuration"

menu "General Setup"

config TTY_VGA
    bool "VGA text mode"
    help
        Use text mode with default 80x25 resolution
    default n


config TTY_VBE
    bool "VESA BIOS Extension graphics mode"
    help
        Use VESA BIOS Extension for graphics mode (bigger resolutions)
    default y

endmenu
```

## Kconfig
```kconfig
mainmenu "MyOS x86_32 Kernel Configuration"

menu "General Setup"

choice
    prompt "Video mode"
    default TTY_VGA

config TTY_VGA
    bool "VGA text mode"
    help
        Use text mode with default 80x25 resolution

config TTY_VBE
    bool "VESA BIOS Extension graphics mode"
    help
        Use VESA BIOS Extension for graphics mode (bigger resolutions)

endchoice


config TTY_VBE_WIDTH
    int "Graphics mode width"
    help
        Choose the width
    depends on TTY_VBE
    default 1920

config TTY_VBE_HEIGHT
    int "Graphics mode height"
    help
        Choose the height
    depends on TTY_VBE
    default 1080

config VERBOSE
    bool "Show kernel messages"
    help
        Enable to print kernel messages
    default n

config RTC
    bool "Real time clock"
    default y
    help
        Enable the real time clock, this configuration will make the 'datetime' command available

endmenu

source kernel/Kconfig
```

## kernel/Kconfig
```kconfig
menu "Memory manager"

menu "Physical memory manager"

endmenu

menu "Virtual memory manager"

config VMM_PAGING
    bool "Paging"
    help
        Enable support for paging
    default y
    select VMM_PAGING_4K

config VMM_PAGING_4K
    bool "4KB pages"
    help
        Enalbe support for 4KB pages
    depends on VMM_PAGING
    default y

config READ_AFTER_FREE_PROT
    bool "kmalloc read after free protection"
    help
        Fill memory with zeros after freed
    default y

endmenu

endmenu

menu "Scheduler"

choice
    prompt "Scheduling algorithm"
    default ROUND_ROBIN

config ROUND_ROBIN
    bool "Round-Robin"
    help
        Help message

config SIMPLE_SCH
    bool "Simple"
    help
        Help message

endchoice

config RR_TIME_QUANTUM
    int "Round-Robin time quantum"
    help
        Help message
    depends on ROUND_ROBIN
    default 20

endmenu

menu "Shell"

config SH_HOSTNAME
    string "Choose hostname"
    help
        Help message
    default "myos"

config SH_HISTORY
    bool "Shell history"
    help
        Help message
    default n

config SH_HISTORY_MAX_SIZE
    int "History size"
    help
        Help message
    depends on SH_HISTORY
    default 20

choice
    prompt "Terminal background color"
    default SH_BKC_BLACK

config SH_BKC_BLACK
    bool "Black"

config SH_BKC_BLUE
    bool "Blue"
    
config SH_BKC_GREEN
    bool "Green"

config SH_BKC_CYAN
    bool "Cyan"

config SH_BKC_RED
    bool "Red"

config SH_BKC_MAGENTA
    bool "Magenta"

config SH_BKC_BROWN
    bool "Brown"

config SH_BKC_LIGHT_GREY
    bool "Light Grey"

config SH_BKC_DARK_GREY
    bool "Dark Grey"

config SH_BKC_LIGHT_BLUE
    bool "Light Blue"

config SH_BKC_LIGHT_GREEN
    bool "Light Green"

config SH_BKC_LIGHT_CYAN
    bool "Light Cyan"

config SH_BKC_LIGHT_RED
    bool "Light Red"

config SH_BKC_LIGHT_MAGENTA
    bool "Light Magenta"

config SH_BKC_LIGHT_BROWN
    bool "Light Brown"

config SH_BKC_WHITE
    bool "White"

endchoice

choice
    prompt "Terminal text color"
    default SH_FGC_WHITE

config SH_FGC_WHITE
    bool "White"

config SH_FGC_BLACK
    bool "Black"

config SH_FGC_BLUE
    bool "Blue"

config SH_FGC_GREEN
    bool "Green"

config SH_FGC_CYAN
    bool "Cyan"

config SH_FGC_RED
    bool "Red"

config SH_FGC_MAGENTA
    bool "Magenta"

config SH_FGC_BROWN
    bool "Brown"

config SH_FGC_LIGHT_GREY
    bool "Light Grey"

config SH_FGC_DARK_GREY
    bool "Dark Grey"

config SH_FGC_LIGHT_BLUE
    bool "Light Blue"

config SH_FGC_LIGHT_GREEN
    bool "Light Green"

config SH_FGC_LIGHT_CYAN
    bool "Light Cyan"

config SH_FGC_LIGHT_RED
    bool "Light Red"

config SH_FGC_LIGHT_MAGENTA
    bool "Light Magenta"

config SH_FGC_LIGHT_BROWN
    bool "Light Brown"

endchoice

endmenu
```
